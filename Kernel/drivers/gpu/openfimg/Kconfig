## Kernel/drivers/gpu/openfimg/Kconfig
```kconfig
config OPENFIMG
	tristate "OpenFIMG kernel driver for Samsung FIMG-3DSE GPU"
	depends on CPU_S5P6442
	help
	  Chose this option to enable OpenFIMG kernel driver for Samsung
	  FIMG-3DSE GPU.
```

## Kernel/drivers/media/s5p6442/openg2d/Kconfig
```kconfig
#
## G2D subsystem configuration
##
#
##menu "G2D Support"

config OPENG2D
	bool "TOM3Q FIMG-2D Driver"
        depends on CPU_S5P6442
	default n
	help
	    FIMG-2D
#endmenu
```
